## config/west.yml
```yaml
manifest:
  remotes:
    - name: zmkfirmware
      url-base: https://github.com
    - name: urob
      url-base: https://github.com
  projects:
    - name: zmk
      remote: zmkfirmware
      revision: v0.3
      import: app/west.yml
    - name: zmk-nodefree-config
      remote: urob
      revision: main
      # REMOVE the 'path:' line entirely. 
      # Let west put it in the default 'modules/' folder.
  self:
    path: config
```
